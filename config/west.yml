## config/west.yml
```yaml
manifest:
  remotes:
    - name: zmkfirmware
      url-base: https://github.com/zmkfirmware
    - name: modu-c-upstream
      url-base: https://github.com/kjmin0228

  projects:
    - name: zmk
      remote: zmkfirmware
      revision: 641514a97db345f499dd50b0360e594270f008fe
      import: app/west.yml

    - name: modu-c-firmware
      remote: modu-c-upstream
      revision: 97bf654b7904720641a732a7ed66d2e7e9d013d2
      path: modu-c-firmware

  self:
    path: config
```
